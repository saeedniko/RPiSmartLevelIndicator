/dts-v1/;
/plugin/;
/ {
	compatible = "brcm,bcm2711"; 					// indicates compability with the broadcom bcm2711 driver. Used by rpi. 
	fragment@0 { 									// This is a device tree fragment
		target-path = "/"; 							// path to where overlay will be applied
		__overlay__ {								// indicates that all following properties will be overlaid onto the base device tree.
			my_device {								// defines a new device node named "my_device".
				compatible = "my_hc_sr04";			// compatible string for device (must match driver)
				status = "okay";
				label = "HC-SR04 Driver";
				trigger-gpio = <&gpio 18 0>;
				echo-gpio <&gpio 24 2>; 
			};
		};
	};
};